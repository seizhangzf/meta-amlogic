## conf/machine/mesons4-lib32-ap229-vmx.conf
```bitbake
include conf/machine/mesons4_ap229.inc

UBOOT_MACHINE = "s4_ap229_s905c3eng_config"
TDK_VERSION_s4 = "v3.8/dev/S905C3ENG"
#DISTRO_FEATURES_append = " verimatrix "
DISTRO_FEATURES_append = " aml-cas "
```

## conf/machine/mesons4-lib32-aq223.conf
```bitbake
include conf/machine/mesons4_aq222.inc

MACHINE_ESSENTIAL_EXTRA_RRECOMMENDS_remove = " wififw-qca6174 qca6174"
KERNEL_MODULE_AUTOLOAD_remove = " btqca "
KERNEL_MODULE_PROBECONF_remove = " btqca "

MACHINE_ESSENTIAL_EXTRA_RRECOMMENDS_append = " aml-wifi-w1 aml-bt-w1"
DISTRO_FEATURES_append = " aml-w1 "
DISTRO_FEATURES_append = " aml-iptv"

DISTRO_FEATURES_remove = " netflix "
```

## conf/machine/mesons4d_ap232.inc
```bitbake
#@TYPE: Machine
#@NAME: meson

#@DESCRIPTION: Machine configuration for meson systems

include conf/machine/include/mesons4.inc
require conf/machine/include/amlogic_64b.inc

PREFERRED_PROVIDER_virtual/egl = "libgles-eabihf-dvalin-wayland-drm"
PREFERRED_PROVIDER_virtual/libgl = "libgles-eabihf-dvalin-wayland-drm"
PREFERRED_PROVIDER_virtual/libgles1 = "libgles-eabihf-dvalin-wayland-drm"
PREFERRED_PROVIDER_virtual/libgles2 = "libgles-eabihf-dvalin-wayland-drm"

MACHINE_ESSENTIAL_EXTRA_RRECOMMENDS += " \
        wififw-qca6174 \
        qca6174 \
        aucpu-fw \
        tuner-prebuilt \
        "

KERNEL_DEVICETREE = "s4d_s905c3_ap232_linux.dtb"

KERNEL_MODULE_AUTOLOAD += " cxd2856_fe_64 r836_fe_64 av2018_fe_64 "
KERNEL_MODULE_AUTOLOAD += " snd-soc-dummy_codec"
KERNEL_MODULE_AUTOLOAD += " snd-soc-aml_t9015"
KERNEL_MODULE_AUTOLOAD += "aml_aucpu"
KERNEL_MODULE_AUTOLOAD += "meson_ir"
KERNEL_MODULE_AUTOLOAD += " btqca"
KERNEL_MODULE_PROBECONF += "btqca"
KERNEL_MODULE_AUTOLOAD += " hci_uart"
KERNEL_MODULE_PROBECONF += "hci_uart"
KERNEL_MODULE_AUTOLOAD += " dolby_fw"
KERNEL_MODULE_AUTOLOAD += "meson-cpufreq"
KERNEL_MODULE_AUTOLOAD += " media_sync"

UBOOT_MACHINE = "s4_ap232_config"
DISTRO_FEATURES_append = " drm"
DISTRO_FEATURES_append = " onepass"
DISTRO_FEATURES_append = " secure-u-boot optee "
DISTRO_FEATURES_append = " absystem"
DISTRO_FEATURES_append = " opencdm "
DISTRO_FEATURES_append = " widevine "
DISTRO_FEATURES_append = " playready "
DISTRO_FEATURES_append = " amlogic-dvb "
DISTRO_FEATURES_append = " bluetooth bluez5 "
DISTRO_FEATURES_remove = " alsa "
OVERRIDES .= ":ap222:ap232:s4:onepass"
MACHINEOVERRIDES .= ":client"
OVERRIDES .= ":dtv"
DISTRO_FEATURES_append = " dvb"
DISTRO_FEATURES_append = " aml-iptv"
PREFERRED_PROVIDER_widevine = "aml-mediadrm-widevine"
DISTRO_FEATURES_remove_dunfell = " virtualization"
TDK_VERSION_s4 = "v3.8/dev/S905C3"
# dm-verity
#DISTRO_FEATURES_append = " dm-verity"
#DISTRO_FEATURES_NATIVE_append = " dm-verity"
```

## conf/machine/mesonsc2-5.4-lib32-ah212-pip.conf
```bitbake
include conf/machine/mesonsc2_5.4_ah212.inc

KERNEL_DEVICETREE = "sc2_s905x4_ah212_pip_linux.dtb"
KERNEL_MODULE_AUTOLOAD += "mxl258c_fe_64"
OVERRIDES .= ":ah212-pip:sc2:onepass"
```

## conf/machine/mesonsc2-5.4-lib32-ah212-vmx.conf
```bitbake
include conf/machine/mesonsc2_5.4_ah212.inc

DISTRO_FEATURES_append = " verimatrix "
DISTRO_FEATURES_append = " aml-cas "
```

## conf/machine/mesonsc2-5.4-lib32-ah232-synamedia.conf
```bitbake
include conf/machine/mesonsc2_5.4_ah232.inc

DISTRO_FEATURES_append = " synamedia "

#For changed from s905c2 to S905C2ENG
TDK_VERSION_sc2 = "v3.8/dev/S905C2ENG"
TDK_VERSION_sc2-5.4 = "v3.8/dev/S905C2ENG"
```

## conf/machine/mesonsc2-5.4-lib32-ah232-vmx.conf
```bitbake
include conf/machine/mesonsc2_5.4_ah232.inc

DISTRO_FEATURES_append = " verimatrix "
```

## conf/machine/mesonsc2_5.4_ah232.inc
```bitbake
#@TYPE: Machine
#@NAME: meson

#@DESCRIPTION: Machine configuration for meson systems

include conf/machine/include/mesonsc2_5.4.inc

PREFERRED_PROVIDER_virtual/egl = "libgles-eabihf-dvalin-wayland-drm"
PREFERRED_PROVIDER_virtual/libgl = "libgles-eabihf-dvalin-wayland-drm"
PREFERRED_PROVIDER_virtual/libgles1 = "libgles-eabihf-dvalin-wayland-drm"
PREFERRED_PROVIDER_virtual/libgles2 = "libgles-eabihf-dvalin-wayland-drm"

MACHINE_ESSENTIAL_EXTRA_RRECOMMENDS += " \
        wififw-qca6174 \
        qca6174 \
        aucpu-fw \
        tuner-prebuilt \
        "

KERNEL_DEVICETREE = "sc2_s905x4_ah212_linux.dtb"
KERNEL_MODULE_AUTOLOAD += " btqca"
KERNEL_MODULE_PROBECONF += "btqca"
KERNEL_MODULE_AUTOLOAD += " hci_uart"
KERNEL_MODULE_PROBECONF += "hci_uart"
KERNEL_MODULE_AUTOLOAD += "cxd2856_fe_64"
KERNEL_MODULE_AUTOLOAD += "aml_aucpu"
KERNEL_MODULE_AUTOLOAD += "dvb_demux"
KERNEL_MODULE_AUTOLOAD += "meson_ir"
KERNEL_MODULE_AUTOLOAD += "snd-soc-dummy_codec"
KERNEL_MODULE_AUTOLOAD += "snd-soc-aml_t9015"
KERNEL_MODULE_AUTOLOAD += "dolby_fw"
KERNEL_MODULE_AUTOLOAD += "meson-cpufreq"

UBOOT_MACHINE = "sc2_ah232_config"
DISTRO_FEATURES_append = " drm"
DISTRO_FEATURES_append = " onepass"
DISTRO_FEATURES_append = " secure-u-boot optee "
DISTRO_FEATURES_append = " absystem"
DISTRO_FEATURES_append = " opencdm "
DISTRO_FEATURES_append = " widevine "
DISTRO_FEATURES_append = " playready "
DISTRO_FEATURES_append = " amlogic-dvb "
DISTRO_FEATURES_append = " bluetooth bluez5 "
DISTRO_FEATURES_append = " ptest "
DISTRO_FEATURES_remove = " alsa "

OVERRIDES .= ":ah212:sc2-5.4:onepass"
MACHINEOVERRIDES .= ":client"
PREFERRED_PROVIDER_widevine = "aml-mediadrm-widevine"

PREFERRED_VERSION_wayland = "1.17.0"
PREFERRED_VERSION_wayland-protocol = "1.18.0"

DISTRO_FEATURES_remove_dunfell = " virtualization"
TDK_VERSION_sc2 = "v3.8/dev/S905C2"
TDK_VERSION_sc2-5.4 = "v3.8/dev/S905C2"
```

## conf/machine/mesonsc2_ah212.conf
```bitbake
#@TYPE: Machine
#@NAME: meson

#@DESCRIPTION: Machine configuration for meson systems

include conf/machine/include/mesonsc2.inc
require conf/machine/include/amlogic_32b.inc

PREFERRED_PROVIDER_virtual/egl = "libgles-eabihf-dvalin-wayland-drm"
PREFERRED_PROVIDER_virtual/libgl = "libgles-eabihf-dvalin-wayland-drm"
PREFERRED_PROVIDER_virtual/libgles1 = "libgles-eabihf-dvalin-wayland-drm"
PREFERRED_PROVIDER_virtual/libgles2 = "libgles-eabihf-dvalin-wayland-drm"

MACHINE_ESSENTIAL_EXTRA_RRECOMMENDS += " \
        wififw-qca6174 \
        qca6174 \
        aucpu-fw \
        cxd2856-tuner \
        "

KERNEL_DEVICETREE = "sc2_s905x4_ah212_drm_buildroot.dtb"
KERNEL_MODULE_AUTOLOAD += " btqca"
KERNEL_MODULE_PROBECONF += "btqca"
KERNEL_MODULE_AUTOLOAD += " hci_uart"
KERNEL_MODULE_PROBECONF += "hci_uart"
KERNEL_MODULE_AUTOLOAD += "cxd2856_fe_32"
KERNEL_MODULE_AUTOLOAD += "aml_aucpu"
KERNEL_MODULE_AUTOLOAD += "dvb_demux"

UBOOT_MACHINE = "sc2_ah212_config"
DISTRO_FEATURES_append = " drm"
DISTRO_FEATURES_append = " onepass"
DISTRO_FEATURES_append = " secure-u-boot optee "
DISTRO_FEATURES_append = " absystem"
DISTRO_FEATURES_append = " opencdm "
DISTRO_FEATURES_append = " widevine "
DISTRO_FEATURES_append = " playready "
DISTRO_FEATURES_append = " amlogic-dvb "
DISTRO_FEATURES_append = " bluetooth "
DISTRO_FEATURES_remove = " alsa "
OVERRIDES .= ":ah212:sc2:onepass"
MACHINEOVERRIDES .= ":client"
PREFERRED_PROVIDER_widevine = "aml-mediadrm-widevine"
```

## conf/machine/mesont5d_am301.conf
```bitbake
#@TYPE: Machine
#@NAME: meson

#@DESCRIPTION: Machine configuration for meson systems

include conf/machine/include/mesont5d.inc
require conf/machine/include/amlogic_32b.inc

PREFERRED_PROVIDER_virtual/egl = "libgles-eabihf-dvalin-wayland-drm"
PREFERRED_PROVIDER_virtual/libgl = "libgles-eabihf-dvalin-wayland-drm"
PREFERRED_PROVIDER_virtual/libgles1 = "libgles-eabihf-dvalin-wayland-drm"
PREFERRED_PROVIDER_virtual/libgles2 = "libgles-eabihf-dvalin-wayland-drm"

#MACHINE_ESSENTIAL_EXTRA_RRECOMMENDS += " \
#        wififw-ap6398 \
#        ap6xxx \
#        "

KERNEL_DEVICETREE = "t5d_t950d4_am301_drm_1g.dtb t5d_t950d4_am301_drm_1.5g.dtb"
UBOOT_MACHINE = "t5d_am301_v1"
DISTRO_FEATURES_append = " drm"
DISTRO_FEATURES_append = " onepass"
DISTRO_FEATURES_append = " secure-u-boot optee "
#DISTRO_FEATURES_append = " absystem"
DISTRO_FEATURES_append = " opencdm "
DISTRO_FEATURES_append = " widevine "
DISTRO_FEATURES_append = " playready "
DISTRO_FEATURES_append = " amlogic-tv "
DISTRO_FEATURES_append = " amlogic-dvb "
DISTRO_FEATURES_remove = " alsa "
OVERRIDES .= ":am301:t5d:onepass"
MACHINEOVERRIDES .= ":client"
PREFERRED_PROVIDER_widevine = "aml-mediadrm-widevine"
```

## conf/machine/mesont5w-5.4-lib32-at301.conf
```bitbake
#@TYPE: Machine
#@NAME: meson

#@DESCRIPTION: Machine configuration for meson systems

include conf/machine/include/mesont5w_5.4.inc
#require conf/machine/include/amlogic_32b.inc

PREFERRED_PROVIDER_virtual/egl = "libgles-eabihf-dvalin-wayland-drm"
PREFERRED_PROVIDER_virtual/libgl = "libgles-eabihf-dvalin-wayland-drm"
PREFERRED_PROVIDER_virtual/libgles1 = "libgles-eabihf-dvalin-wayland-drm"
PREFERRED_PROVIDER_virtual/libgles2 = "libgles-eabihf-dvalin-wayland-drm"

MACHINE_ESSENTIAL_EXTRA_RRECOMMENDS += " \
        rtk8822cu \
        realtek-btusb \
        realtek-btuart \
        realtek-hciattach \
        pq-prebuilt \
        tuner-prebuilt \
        optee-linux-driver \
        "

KERNEL_DEVICETREE = "t5w_t962d4_at301_linux.dtb"
UBOOT_MACHINE = "t5w_at301_v1"
KERNEL_MODULE_AUTOLOAD += " snd-soc-dummy_codec"
KERNEL_MODULE_AUTOLOAD += " snd-soc-aml_t9015"
KERNEL_MODULE_AUTOLOAD += " snd-soc-aml_codec_tl1_acodec"
KERNEL_MODULE_AUTOLOAD += " snd-soc-tas5805"
KERNEL_MODULE_AUTOLOAD += " meson_ir"
KERNEL_MODULE_AUTOLOAD += "aml_aucpu"
KERNEL_MODULE_AUTOLOAD += "dolby_fw"
KERNEL_MODULE_AUTOLOAD += "meson-cpufreq"
KERNEL_MODULE_AUTOLOAD += " dnlp_alg_64 si2151_fe_64 rt710_fe_64 "

DISTRO_FEATURES_append = " drm"
DISTRO_FEATURES_append = " onepass"
DISTRO_FEATURES_append = " secure-u-boot optee "
DISTRO_FEATURES_append = " absystem"
DISTRO_FEATURES_append = " opencdm "
DISTRO_FEATURES_append = " widevine "
DISTRO_FEATURES_append = " playready "
DISTRO_FEATURES_append = " amlogic-tv "
DISTRO_FEATURES_append = " aml-dtv "
DISTRO_FEATURES_append = " amlogic-dvb "
DISTRO_FEATURES_append = " dtvkit"
DISTRO_FEATURES_remove = " alsa "
DISTRO_FEATURES_append = " bluetooth bluez5 "

OVERRIDES .= ":at301:t5w:onepass"
MACHINEOVERRIDES .= ":client"
PREFERRED_PROVIDER_widevine = "aml-mediadrm-widevine"
DISTRO_FEATURES_remove_dunfell = " virtualization"
```

## conf/machine/mesont7-5.4-lib32-an400.conf
```bitbake
#@TYPE: Machine
#@NAME: meson

#@DESCRIPTION: Machine configuration for meson systems

include conf/machine/include/mesont7_5.4.inc

PREFERRED_PROVIDER_virtual/egl = "libgles-eabihf-gondul-wayland-drm"
PREFERRED_PROVIDER_virtual/libgl = "libgles-eabihf-gondul-wayland-drm"
PREFERRED_PROVIDER_virtual/libgles1 = "libgles-eabihf-gondul-wayland-drm"
PREFERRED_PROVIDER_virtual/libgles2 = "libgles-eabihf-gondul-wayland-drm"

MACHINE_ESSENTIAL_EXTRA_RRECOMMENDS += " \
        wififw-ap6398 \
        ap6xxx \
        optee-linux-driver \
        "

KERNEL_DEVICETREE = "t7_a311d2_an400_linux.dtb"
KERNEL_MODULE_AUTOLOAD += " dhd"
KERNEL_MODULE_PROBECONF += "dhd"
module_conf_dhd = "options dhd firmware_path=/etc/wifi/6398/ nvram_path=/etc/wifi/6398/"
KERNEL_MODULE_AUTOLOAD += " snd-soc-dummy_codec"
KERNEL_MODULE_AUTOLOAD += " snd-soc-aml_t9015"
KERNEL_MODULE_AUTOLOAD += " snd-soc-tas5707"
KERNEL_MODULE_AUTOLOAD += " snd-soc-aml_codec_tl1_acodec"
KERNEL_MODULE_AUTOLOAD += " meson_ir"
KERNEL_MODULE_AUTOLOAD += " hci_uart"
KERNEL_MODULE_PROBECONF += "hci_uart"
KERNEL_MODULE_AUTOLOAD += "dolby_fw"
KERNEL_MODULE_AUTOLOAD += "meson-cpufreq"
KERNEL_MODULE_AUTOLOAD += " media_sync"

UBOOT_MACHINE = "t7_an400_lpddr4x_config"
DISTRO_FEATURES_append = " drm"
DISTRO_FEATURES_append = " onepass"
DISTRO_FEATURES_append = " secure-u-boot optee "
DISTRO_FEATURES_append = " absystem"
DISTRO_FEATURES_append = " opencdm "
DISTRO_FEATURES_append = " widevine "
DISTRO_FEATURES_append = " playready "
DISTRO_FEATURES_append = " aml-dtv "
DISTRO_FEATURES_append = " aml-libjpeg"
DISTRO_FEATURES_append = " aml-libmultienc"
DISTRO_FEATURES_append = " bluetooth bluez5 "
DISTRO_FEATURES_append = " ptest "
DISTRO_FEATURES_append = " AVB "
DISTRO_FEATURES_remove = " alsa "
OVERRIDES .= ":an400:t7:onepass"
MACHINEOVERRIDES .= ":client"
OVERRIDES .= ":dtv"
PREFERRED_PROVIDER_widevine = "aml-mediadrm-widevine"

PREFERRED_VERSION_wayland = "1.17.0"
PREFERRED_VERSION_wayland-protocol = "1.18.0"
DISTRO_FEATURES_remove_dunfell = " virtualization"
#READONLY = "y"
# dm-verity
DISTRO_FEATURES_append = " ${@bb.utils.contains('READONLY', 'y', 'dm-verity', '', d)}"
DISTRO_FEATURES_NATIVE_append = " ${@bb.utils.contains('READONLY', 'y', 'dm-verity', '', d)}"

#Xconf Firmware Upgrade
XCONF_MODELNAME = "AN400"

DISTRO_FEATURES_append = " aml-isp"
```

## conf/machine/mesontm2_ab301.conf
```bitbake
#@TYPE: Machine
#@NAME: meson

#@DESCRIPTION: Machine configuration for meson systems

include conf/machine/include/mesontm2.inc
require conf/machine/include/amlogic_32b.inc

PREFERRED_PROVIDER_virtual/egl = "libgles-eabihf-dvalin-wayland-drm"
PREFERRED_PROVIDER_virtual/libgl = "libgles-eabihf-dvalin-wayland-drm"
PREFERRED_PROVIDER_virtual/libgles1 = "libgles-eabihf-dvalin-wayland-drm"
PREFERRED_PROVIDER_virtual/libgles2 = "libgles-eabihf-dvalin-wayland-drm"

MACHINE_ESSENTIAL_EXTRA_RRECOMMENDS += " \
        wififw-ap6398 \
        ap6xxx \
        pq-prebuilt \
        "

KERNEL_DEVICETREE = "tm2_t962x3_ab301_drm_buildroot.dtb"
UBOOT_MACHINE = "tm2_t962x3_ab301_v1_config"
KERNEL_MODULE_AUTOLOAD += " dhd dnlp_alg_32 ldim_alg_32 "
KERNEL_MODULE_PROBECONF += "dhd"
module_conf_dhd = "options dhd firmware_path=/etc/wifi/6398/ nvram_path=/etc/wifi/6398/nvram.txt"
DISTRO_FEATURES_append = " drm"
DISTRO_FEATURES_append = " onepass"
DISTRO_FEATURES_append = " secure-u-boot optee "
DISTRO_FEATURES_append = " absystem"
DISTRO_FEATURES_append = " opencdm "
DISTRO_FEATURES_append = " widevine "
#DISTRO_FEATURES_remove = " alsa "
OVERRIDES .= ":ab301:tm2:onepass"
MACHINEOVERRIDES .= ":client:wpe:thunder"
PREFERRED_PROVIDER_widevine = "aml-mediadrm-widevine"
```

## conf/machine/mesontm2_ab311.conf
```bitbake
#@TYPE: Machine
#@NAME: meson

#@DESCRIPTION: Machine configuration for meson systems

include conf/machine/include/mesontm2.inc
require conf/machine/include/amlogic_32b.inc

PREFERRED_PROVIDER_virtual/egl = "libgles-eabihf-dvalin-wayland-drm"
PREFERRED_PROVIDER_virtual/libgl = "libgles-eabihf-dvalin-wayland-drm"
PREFERRED_PROVIDER_virtual/libgles1 = "libgles-eabihf-dvalin-wayland-drm"
PREFERRED_PROVIDER_virtual/libgles2 = "libgles-eabihf-dvalin-wayland-drm"

MACHINE_ESSENTIAL_EXTRA_RRECOMMENDS += " \
        wififw-ap6398 \
        ap6xxx \
        pq-prebuilt \
        "

KERNEL_DEVICETREE = "tm2_t962e2_ab311_drm.dtb"
UBOOT_MACHINE = "tm2_t962e2_ab311_v1_config"
KERNEL_MODULE_AUTOLOAD += " dhd"
KERNEL_MODULE_PROBECONF += "dhd"
module_conf_dhd = "options dhd firmware_path=/etc/wifi/6398/ nvram_path=/etc/wifi/6398/nvram.txt"
DISTRO_FEATURES_append = " drm"
DISTRO_FEATURES_append = " onepass"
DISTRO_FEATURES_append = " secure-u-boot optee "

OVERRIDES .= ":ab311:tm2:onepass"
MACHINEOVERRIDES .= ":client"
```
