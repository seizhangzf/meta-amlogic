## conf/machine/mesontm2_ab311_wayland_drm.conf
```bitbake
#@TYPE: Machine
#@NAME: meson

#@DESCRIPTION: Machine configuration for meson systems

include conf/machine/include/mesontm2.inc
include conf/machine/include/amlogic.inc

MACHINE_ESSENTIAL_EXTRA_RRECOMMENDS += " \
        ap6xxx \
        brcm-bsa-kernel \
        tuner-64 \
        "
KERNEL_DEVICETREE = "tm2_t962e2_ab311_drm.dtb"
UBOOT_MACHINE = "tm2_t962e2_ab311_v1"
KERNEL_MODULE_AUTOLOAD += "dhd si2151_fe_64"
KERNEL_MODULE_PROBECONF += "dhd"
module_conf_dhd = "options dhd firmware_path=/etc/wifi/6398/ nvram_path=/etc/wifi/6398/nvram.txt"
DISTRO_FEATURES_append = " drm"
OVERRIDES .= ":ab311"
```

## conf/machine/mesontm2_ab311_wayland_drm_playready.conf
```bitbake
#@TYPE: Machine
#@NAME: meson

#@DESCRIPTION: Machine configuration for meson systems

include conf/machine/include/mesongtm2.inc

MACHINE_ESSENTIAL_EXTRA_RRECOMMENDS += " \
        ap6xxx \
        media-modules \
        optee-linux-driver \
        brcm-bsa-kernel \
        tuner-64 \
        "

MACHINE_EXTRA_RRECOMMENDS = " kernel-modules kernel-devicetree"

EXTRA_IMAGEDEPENDS += "u-boot"

#include conf/machine/include/tune-cortexa53.inc
require conf/machine/include/arm/arch-armv8.inc
require conf/machine/include/amlogic.inc

#DEFAULTTUNE = "cortexa53_64-crypto"

IMAGE_FSTYPES += "tar.gz ext4 cpio.gz"
#IMAGE_FSTYPES += "cpio.gz.u-boot"
#IMAGE_CLASSES += "image_types_uboot"

IMAGE_FSTYPES_DEBUGFS = ""

SERIAL_CONSOLE = "115200 ttyS0"

PREFERRED_PROVIDER_virtual/kernel ?= "linux-meson"

KERNEL_IMAGETYPE = "Image.gz"
KERNEL_DEVICETREE = "tm2_t962e2_ab311_drm.dtb"
UBOOT_SUFFIX = "bin"
UBOOT_MACHINE = "tm2_t962e2_ab311_v1"

MACHINE_FEATURES = "usbgadget usbhost vfat alsa"

IMAGE_BOOT_FILES ?= "u-boot.${UBOOT_SUFFIX}"

INITRAMFS_FILES = "initramfs-default"

KERNEL_MODULE_AUTOLOAD += "mali dhd si2151_fe_64"
KERNEL_MODULE_PROBECONF += "dhd"
module_conf_dhd = "options dhd firmware_path=/etc/wifi/6398/ nvram_path=/etc/wifi/6398/nvram.txt"
# append drm(wayland drm backend)
DISTRO_FEATURES_append = " drm"
OVERRIDES .= ":ab311:tm2"
PREFERRED_PROVIDER_virtual/gpu ?= "dvalin"
```

## conf/machine/mesontm2_lama_wayland_drm.conf
```bitbake
#@TYPE: Machine
#@NAME: meson

#@DESCRIPTION: Machine configuration for meson systems

include conf/machine/include/mesongtm2.inc
include conf/machine/include/amlogic.inc

MACHINE_ESSENTIAL_EXTRA_RRECOMMENDS += " \
        qca6174 \
        tuner-64 \
        "

KERNEL_DEVICETREE = "tm2_t962e2_sky_drm.dtb"
UBOOT_MACHINE = "tm2_t962e2_ab311_v1"
KERNEL_MODULE_AUTOLOAD += "si2151_fe_64 wlan"
DISTRO_FEATURES_append = " drm"
OVERRIDES .= ":ab311:lama"
```

## conf/machine/mesontm2_lama_wayland_drm_32b.conf
```bitbake
#@TYPE: Machine
#@NAME: meson

#@DESCRIPTION: Machine configuration for meson systems

require conf/machine/include/amlogic_32b.inc
require conf/machine/include/amlogic_common_32.inc

PREFERRED_PROVIDER_virtual/egl = "libgles-eabihf-dvalin-wayland-drm"
PREFERRED_PROVIDER_virtual/libgl = "libgles-eabihf-dvalin-wayland-drm"
PREFERRED_PROVIDER_virtual/libgles1 = "libgles-eabihf-dvalin-wayland-drm"
PREFERRED_PROVIDER_virtual/libgles2 = "libgles-eabihf-dvalin-wayland-drm"

MACHINE_ESSENTIAL_EXTRA_RRECOMMENDS += " \
        wififw-qca6174 \
        "

OVERRIDES .= ":ab311:tm2:sky"
```

## conf/machine/mesontm2_t962e2_llama.conf
```bitbake
#@TYPE: Machine
#@NAME: meson

#@DESCRIPTION: Machine configuration for meson systems

include conf/machine/include/mesontm2.inc
require conf/machine/include/amlogic_32b.inc

PREFERRED_PROVIDER_virtual/egl = "libgles-eabihf-dvalin-wayland-drm"
PREFERRED_PROVIDER_virtual/libgl = "libgles-eabihf-dvalin-wayland-drm"
PREFERRED_PROVIDER_virtual/libgles1 = "libgles-eabihf-dvalin-wayland-drm"
PREFERRED_PROVIDER_virtual/libgles2 = "libgles-eabihf-dvalin-wayland-drm"

MACHINE_ESSENTIAL_EXTRA_RRECOMMENDS += " \
        qca6174 \
        wififw-qca6174 \
        "

KERNEL_DEVICETREE = "tm2_t962e2_llama_drm.dtb"
UBOOT_MACHINE = "tm2_t962e2_ab311_v1"
KERNEL_MODULE_AUTOLOAD += " wlan"
DISTRO_FEATURES_append = " drm"
DISTRO_FEATURES_append = " onepass"

OVERRIDES .= ":ab311:tm2:llama:onepass"
```

## conf/machine/mesontm2_t962x3_llama.conf
```bitbake
#@TYPE: Machine
#@NAME: meson

#@DESCRIPTION: Machine configuration for meson systems

include conf/machine/include/mesontm2.inc
require conf/machine/include/amlogic_32b.inc

PREFERRED_PROVIDER_virtual/egl = "libgles-eabihf-dvalin-wayland-drm"
PREFERRED_PROVIDER_virtual/libgl = "libgles-eabihf-dvalin-wayland-drm"
PREFERRED_PROVIDER_virtual/libgles1 = "libgles-eabihf-dvalin-wayland-drm"
PREFERRED_PROVIDER_virtual/libgles2 = "libgles-eabihf-dvalin-wayland-drm"

#MACHINE_ESSENTIAL_EXTRA_RRECOMMENDS += " \
#        tuner-prebuilt \
#        "
#qca6174 
#wififw-qca6174 



KERNEL_DEVICETREE = "tm2_t962x3_llama_drm.dtb"
UBOOT_MACHINE = "tm2_t962x3_ab301_v1_config"
#KERNEL_MODULE_AUTOLOAD += " wlan si2168_fe_32"
KERNEL_MODULE_AUTOLOAD += " si2168_fe"
DISTRO_FEATURES_append = " drm"
DISTRO_FEATURES_append = " onepass"

OVERRIDES .= ":llama:tm2:sky:onepass"
```

## conf/machine/mesontxlx_r321_wayland_drm.conf
```bitbake
#@TYPE: Machine
#@NAME: meson

include conf/machine/include/mesongxl.inc
include conf/machine/include/amlogic.inc

MACHINE_ESSENTIAL_EXTRA_RRECOMMENDS += " \
        ap6xxx \
        wififw-bcm4356 \
        "

KERNEL_DEVICETREE = "txlx_t962e_r321_buildroot.dtb"
UBOOT_MACHINE = "txlx_t962e_r321_v1_config"
KERNEL_MODULE_AUTOLOAD += " dhd"
KERNEL_MODULE_PROBECONF += "dhd"
module_conf_dhd = "options dhd firmware_path=/etc/wifi/4356/ nvram_path=/etc/wifi/4356/nvram.txt"
DISTRO_FEATURES_append = " drm"
OVERRIDES_remove = ":gxl"
OVERRIDES .= ":r321:txlx"
```

## conf/machine/mesontxlx_r321_wayland_drm_32b.conf
```bitbake
#@TYPE: Machine
#@NAME: meson

#@DESCRIPTION: Machine configuration for meson systems

PREFERRED_PROVIDER_virtual/egl = "libgles-eabihf-m450-wayland-drm"
PREFERRED_PROVIDER_virtual/libgl = "libgles-eabihf-m450-wayland-drm"
PREFERRED_PROVIDER_virtual/libgles1 = "libgles-eabihf-m450-wayland-drm"
PREFERRED_PROVIDER_virtual/libgles2 = "libgles-eabihf-m450-wayland-drm"

require conf/machine/include/amlogic_32b.inc
require conf/machine/include/amlogic_common_32.inc

OVERRIDES .= ":r321:txlx"
```
