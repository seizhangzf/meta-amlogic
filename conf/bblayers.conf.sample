## conf/machine/include/amlogic_srcrev.inc
```bitbake
# armv7at2hf-neon-rdk-linux-gnueabi
SRCREV_pn-libplayer = "19ca046757f026bec28e35ee4b5041d59d669240"
SRCREV_pn-libamavutils = "19ca046757f026bec28e35ee4b5041d59d669240"
SRCREV_pn-aml-dvb = "f523225ce3492df540dcdebdde5dd9089794da7c"
SRCREV_pn-optee-video-firmware = "4090efb1d7cac6991bfd070eda71b988401fdbbe"
SRCREV_pn-aml-zvbi = "f06e974f1382046ede5de9e7890b5bbf51ee57dc"
SRCREV_pn-libgles-eabihf-dvalin-wayland-drm = "2dc59d666792c8b2594260017150e39993766010"
SRCREV_pn-aml-tvserver = "448a3a7cc0a0ac2d394b86d170c496bd82d1b13d"
SRCREV_pn-aml-amaudioutils = "72bc0fb8d471055dbb7c120aaf38e441478cedff"
SRCREV_pn-aml-audio-hal = "d18aa612853ab7cd2c8bbe32e57eb0695bd3ff52"
SRCREV_pn-aml-audio-service = "14cb94e47e42741c11be79637de14754729fabec"
SRCREV_pn-aml-hdcprx = "7d5ee290d949e423e83f26d9f0e2124d174839a2"
SRCREV_pn-aml-provision = "0182e98bd96da714e4519e01123ec2383130bc3f"
SRCREV_tdk_pn-optee-userspace = "54d79932f262dbee7d3e1e997cf906d10454e3cf"
SRCREV_tdk_linuxdriver_pn-optee-userspace = "00131a0ed9da01fcbd7b7c03a2af5aa2f9c3c991"
SRCREV_tdk_keys_pn-optee-userspace = "b0b46d7f57aa98a6f205cbb75774a535292ae418"
SRCREV_pn-wififw = "f745b5ce425bf01fe20bfe49c4018b06ea6a3b9b"
SRCREV_pn-gst-aml-plugins = "b1eb145b5c74dcf8e7d27b6ce11c532c1fc1c2cf"
SRCREV_pn-gst-aml-drm-plugins = "6387002d5dbaa9e78bf3fc3e9ab860be818edaf7"
SRCREV_pn-aml-mediadrm-widevine = "87e71fffe30439747b4ca37363fa41f07a7445aa"
SRCREV_pn-aml-uvm-test = "4090efb1d7cac6991bfd070eda71b988401fdbbe"
SRCREV_pn-android-tools-logcat = "1b888a952480627ae17b9076f1346e8d051c2dff"

# mesontm2_t962e2_llama-rdk-linux-gnueabi
SRCREV_pn-dvalin = "b4f65f1a98bfeb7459ea6bf772697db8af8dea78"
SRCREV_bl31_pn-u-boot = "e8bd850ce4b45e1ea7525994536572e024c48cb0"
SRCREV_bl33_pn-u-boot = "c197eaed51de48cd9f7d02f4b06612845f4bd6ec"
SRCREV_fip_pn-u-boot = "4d9591cbb9508093412d5eee662f4dd1c4038f7b"
SRCREV_bl2_pn-u-boot = "b53874eaba44fa2ce66fefa00c6023730d940b0f"
SRCREV_bl30_pn-u-boot = "c3156bd734ebd820c3e5026ecd94de0421ff87e8"
SRCREV_bl31-1.3_pn-u-boot = "c24caa3c1fd18f4798e4b86110c568bb697c38c2"

SRCREV_tdk_pn-optee-linux-driver = "54d79932f262dbee7d3e1e997cf906d10454e3cf"
SRCREV_tdk_linuxdriver_pn-optee-linux-driver = "00131a0ed9da01fcbd7b7c03a2af5aa2f9c3c991"
SRCREV_tdk_keys_pn-optee-linux-driver = "b0b46d7f57aa98a6f205cbb75774a535292ae418"
SRCREV_pn-qca6174 = "6a1ac03a95b3c1ecec712f649f6d66d8a56b464c"
# mesontm2_t962e2_llama-rdk-linux-gnueabi
SRCREV_pn-media-modules = "bc26b20a32aa52a80c0ecd83126bc49355815721"
SRCREV_pn-linux-meson = "c042cfeb2e2ea788f27f85f466b64ad80b103394"
SRCREV_pn-devicesettings-hal-amlogic = "31d4cc722883817b5beb74060ba05540316b42f3"
SRCREV_pn-iarmmgrs-hal-amlogic = "da36506e17c9c3600a13f5250be798f5b7bf801d"
```

## conf/machine/include/mesong12a.inc
```bitbake
# common configuration
require conf/machine/include/amlogic_common.inc
PREFERRED_PROVIDER_virtual/gpu ?= "dvalin"
OVERRIDES .= ":g12a"
```

## conf/machine/include/mesong12b.inc
```bitbake
# common configuration
require conf/machine/include/amlogic_common.inc
PREFERRED_PROVIDER_virtual/gpu ?= "gondul"
OVERRIDES .= ":g12b"
```

## conf/machine/include/mesongxl.inc
```bitbake
# common configuration

require conf/machine/include/amlogic_common.inc
PREFERRED_PROVIDER_virtual/gpu ?= "mali450"
OVERRIDES .= ":gxl"
```

## conf/machine/include/mesonsc2.inc
```bitbake
# common configuration
require conf/machine/include/amlogic_common.inc
PREFERRED_VERSION_u-boot = "v2019.%"
PREFERRED_PROVIDER_virtual/gpu ?= "dvalin"
OVERRIDES .= ":sc2"
```

## conf/machine/include/mesonsc2_5.4.inc
```bitbake
# common configuration
require conf/machine/include/amlogic_common.inc
require conf/machine/include/amlogic_64b.inc

PREFERRED_VERSION_u-boot = "v2019.%"
PREFERRED_VERSION_linux-meson = "5.4.%"
#PREFERRED_PROVIDER_virtual/gpu ?= "dvalin"
OVERRIDES .= ":sc2"
```

## conf/machine/include/mesont5d_5.4.inc
```bitbake
# common configuration
require conf/machine/include/amlogic_common.inc
PREFERRED_VERSION_linux-meson = "5.4.%"
PREFERRED_PROVIDER_virtual/gpu ?= "dvalin"
OVERRIDES .= ":t5d"
```

## conf/machine/include/mesont5w_5.4.inc
```bitbake
# common configuration
require conf/machine/include/amlogic_common.inc
require conf/machine/include/amlogic_64b.inc

#PREFERRED_PROVIDER_virtual/gpu ?= "dvalin"
PREFERRED_VERSION_u-boot = "v2015.%"
PREFERRED_VERSION_linux-meson = "5.4.%"
OVERRIDES .= ":t5w"
```

## conf/machine/include/mesontm2.inc
```bitbake
# common configuration

MACHINEOVERRIDES .= ":client"
BBMASK .= "|.*recipes-rdkb"
```

## conf/machine/mesong12a_u200_wayland_drm.conf
```bitbake
#@TYPE: Machine
#@NAME: meson

#@DESCRIPTION: Machine configuration for meson systems

require conf/machine/include/amlogic.inc
include conf/machine/include/mesong12a.inc

MACHINE_ESSENTIAL_EXTRA_RRECOMMENDS += " \
        ap6xxx \
        "

KERNEL_DEVICETREE = "g12a_s905d2_u200_drm_buildroot.dtb"
UBOOT_MACHINE = "g12a_u200_v1_config"
KERNEL_MODULE_AUTOLOAD += " dhd"
KERNEL_MODULE_PROBECONF += "dhd"
module_conf_dhd = "options dhd firmware_path=/etc/wifi/6398/ nvram_path=/etc/wifi/6398/nvram.txt"
# append drm(wayland drm backend)
DISTRO_FEATURES_append = " drm"
OVERRIDES .= ":u200"
```

## conf/machine/mesong12a_u212.conf
```bitbake
#@TYPE: Machine
#@NAME: meson

#@DESCRIPTION: Machine configuration for meson systems

include conf/machine/include/mesong12a.inc
require conf/machine/include/amlogic_32b.inc

PREFERRED_PROVIDER_virtual/egl = "libgles-eabihf-dvalin-wayland-drm"
PREFERRED_PROVIDER_virtual/libgl = "libgles-eabihf-dvalin-wayland-drm"
PREFERRED_PROVIDER_virtual/libgles1 = "libgles-eabihf-dvalin-wayland-drm"
PREFERRED_PROVIDER_virtual/libgles2 = "libgles-eabihf-dvalin-wayland-drm"

MACHINE_ESSENTIAL_EXTRA_RRECOMMENDS += " \
        wififw-ap6398 \
        ap6xxx \
        "

KERNEL_DEVICETREE = "g12a_s905x2_u212_drm_buildroot.dtb"
UBOOT_MACHINE = "g12a_u212_v1_config"
KERNEL_MODULE_AUTOLOAD += " dhd"
KERNEL_MODULE_PROBECONF += "dhd"
module_conf_dhd = "options dhd firmware_path=/etc/wifi/6398/ nvram_path=/etc/wifi/6398/nvram.txt"
DISTRO_FEATURES_append = " drm"
DISTRO_FEATURES_append = " onepass"
DISTRO_FEATURES_append = " secure-u-boot optee "

OVERRIDES .= ":u212:g12a:onepass"
MACHINEOVERRIDES .= ":client"
```

## conf/machine/mesong12a_u212_wayland_drm.conf
```bitbake
#@TYPE: Machine
#@NAME: meson

#@DESCRIPTION: Machine configuration for meson systems

include conf/machine/include/mesong12a.inc
include conf/machine/include/amlogic.inc

MACHINE_ESSENTIAL_EXTRA_RRECOMMENDS += " \
        ap6xxx \
        "

KERNEL_DEVICETREE = "g12a_s905x2_u212_drm_buildroot.dtb"
UBOOT_MACHINE = "g12a_u212_v1_config"
KERNEL_MODULE_AUTOLOAD += " dhd"
KERNEL_MODULE_PROBECONF += "dhd"
module_conf_dhd = "options dhd firmware_path=/etc/wifi/6398/ nvram_path=/etc/wifi/6398/nvram.txt"
DISTRO_FEATURES_append = " drm"
OVERRIDES .= ":u212"
```

## conf/machine/mesong12a_u212_wayland_drm_32b.conf
```bitbake
#@TYPE: Machine
#@NAME: meson

#@DESCRIPTION: Machine configuration for meson systems

require conf/machine/include/amlogic_32b.inc
require conf/machine/include/amlogic_common_32.inc

PREFERRED_PROVIDER_virtual/egl = "libgles-eabihf-dvalin-wayland-drm"
PREFERRED_PROVIDER_virtual/libgl = "libgles-eabihf-dvalin-wayland-drm"
PREFERRED_PROVIDER_virtual/libgles1 = "libgles-eabihf-dvalin-wayland-drm"
PREFERRED_PROVIDER_virtual/libgles2 = "libgles-eabihf-dvalin-wayland-drm"

MACHINE_ESSENTIAL_EXTRA_RRECOMMENDS += " \
        wififw-ap6398 \
        "
#include conf/machine/mesong12a_u212_wayland_drm.conf

OVERRIDES .= ":u212:g12a"
#MACHINEOVERRIDES .= ":wpewesteros:refApp"
#DISTRO_FEATURES_append = " refapp"
```

## conf/machine/mesong12b_w400_wayland_drm.conf
```bitbake
#@TYPE: Machine
#@NAME: meson

#@DESCRIPTION: Machine configuration for meson systems

include conf/machine/include/mesong12b.inc
include conf/machine/include/amlogic.inc

MACHINE_ESSENTIAL_EXTRA_RRECOMMENDS += " \
        ap6xxx \
        "
KERNEL_DEVICETREE = "g12b_a311d_w400_drm_buildroot.dtb"
UBOOT_MACHINE = "g12b_w400_v1_config"
KERNEL_MODULE_AUTOLOAD += "dhd"
KERNEL_MODULE_PROBECONF += "dhd"
module_conf_dhd = "options dhd firmware_path=/etc/wifi/6398/ nvram_path=/etc/wifi/6398/nvram.txt"
DISTRO_FEATURES_append = " drm"
OVERRIDES .= ":w400"
```

## conf/machine/mesongxl_p212_wayland_drm.conf
```bitbake
#@TYPE: Machine
#@NAME: meson

include conf/machine/include/mesongxl.inc
include conf/machine/include/amlogic.inc

MACHINE_ESSENTIAL_EXTRA_RRECOMMENDS += " \
        8189es \
        "

KERNEL_DEVICETREE = "gxl_p212_1g_buildroot.dtb"
UBOOT_MACHINE = "gxl_p212_v1_config"
KERNEL_MODULE_AUTOLOAD += " 8189es"
DISTRO_FEATURES_append = " drm"
OVERRIDES .= ":p212"
```

## conf/machine/mesongxl_p212_wayland_drm_32b.conf
```bitbake
#@TYPE: Machine
#@NAME: meson

#@DESCRIPTION: Machine configuration for meson systems

require conf/machine/include/amlogic_32b.inc
require conf/machine/include/amlogic_common_32.inc

PREFERRED_PROVIDER_virtual/egl = "libgles-eabihf-m450-wayland-drm"
PREFERRED_PROVIDER_virtual/libgl = "libgles-eabihf-m450-wayland-drm"
PREFERRED_PROVIDER_virtual/libgles1 = "libgles-eabihf-m450-wayland-drm"
PREFERRED_PROVIDER_virtual/libgles2 = "libgles-eabihf-m450-wayland-drm"



OVERRIDES .= ":p212:gxl"
```

## conf/machine/mesongxl_p212_wayland_fbdev_32b.conf
```bitbake
#@TYPE: Machine
#@NAME: meson

#@DESCRIPTION: Machine configuration for meson systems

PREFERRED_PROVIDER_virtual/xserver ?= "xserver-xorg"
XSERVER ?= "xserver-xorg \
           xf86-input-evdev \
           xf86-input-mouse \
           xf86-video-fbdev \
           xf86-input-keyboard"

#include conf/machine/include/tune-cortexa53.inc
require conf/machine/include/tune-cortexa8.inc
require conf/machine/include/amlogic_32b.inc
#DEFAULTTUNE = "cortexa53_32-crypto"

PREFERRED_PROVIDER_virtual/egl = "libgles-eabihf-m450-wayland-fbdev"
PREFERRED_PROVIDER_virtual/libgl = "libgles-eabihf-m450-wayland-fbdev"
PREFERRED_PROVIDER_virtual/libgles1 = "libgles-eabihf-m450-wayland-fbdev"
PREFERRED_PROVIDER_virtual/libgles2 = "libgles-eabihf-m450-wayland-fbdev"

IMAGE_FSTYPES += "tar.gz ext4 cpio.gz"
#IMAGE_FSTYPES += "cpio.gz.u-boot"
#IMAGE_CLASSES += "image_types_uboot"

SERIAL_CONSOLE = "115200 ttyS0"

MACHINE_FEATURES = "usbgadget usbhost vfat alsa"

INITRAMFS_FILES = "initramfs-default"

KERNEL_MODULE_AUTOLOAD += "mali 8189es"
#ROOTFS max in KB
IMAGE_ROOTFS_SIZE_mesongxl_p212_32b = "2097152"
DISTRO_FEATURES_remove += "opengl gl"
DISTRO_FEATURES_remove += "parodus"
VIRTUAL-RUNTIME_alsa-state ?= "alsa-states"
DISTRO_FEATURES_append = " rdkbrowser2"
OVERRIDES .= ":p212:gxl"
```

## conf/machine/mesongxl_p230.conf
```bitbake
#@TYPE: Machine
#@NAME: meson

#@DESCRIPTION: Machine configuration for meson systems

PREFERRED_PROVIDER_virtual/xserver ?= "xserver-xorg"
XSERVER ?= "xserver-xorg \
           xf86-input-evdev \
           xf86-input-mouse \
           xf86-video-fbdev \
           xf86-input-keyboard"

PREFERRED_PROVIDER_virtual/libgles1 = "libgles-fbdev-64b"
PREFERRED_PROVIDER_virtual/libgles2 = "libgles-fbdev-64b"
PREFERRED_PROVIDER_virtual/egl = "libgles-fbdev-64b"

include conf/machine/include/mesongxl.inc

MACHINE_ESSENTIAL_EXTRA_RRECOMMENDS += " \
        ap6xxx \
        wififw-bcm4356 \
        media-modules \
        "

MACHINE_EXTRA_RRECOMMENDS = " kernel-modules kernel-devicetree"

EXTRA_IMAGEDEPENDS += "u-boot"

#include conf/machine/include/tune-cortexa53.inc
require conf/machine/include/arm64/arch-armv8.inc
require conf/machine/include/amlogic.inc

#DEFAULTTUNE = "cortexa53_64-crypto"
#IMAGE_FSTYPES_append = " ext4.gz"
IMAGE_FSTYPES += "tar.gz ext4 cpio.gz"
#IMAGE_FSTYPES += "cpio.gz.u-boot"
#IMAGE_CLASSES += "image_types_uboot"
#IMAGE_ROOTFS_ALIGNMENT = "4096"
#EXTRA_IMAGECMD_ext4 += " -L rootfs "

IMAGE_FSTYPES_DEBUGFS = ""

SERIAL_CONSOLE = "115200 ttyS0"

PREFERRED_PROVIDER_virtual/kernel ?= "linux-meson"

KERNEL_IMAGETYPE = "Image.gz"
KERNEL_DEVICETREE = "gxl_p230_2g.dtb"

UBOOT_SUFFIX = "bin"
UBOOT_MACHINE = "gxl_p230_v1_config"

MACHINE_FEATURES = "usbgadget usbhost vfat alsa"

IMAGE_BOOT_FILES ?= "u-boot.${UBOOT_SUFFIX}"

INITRAMFS_FILES = "initramfs-default"

KERNEL_MODULE_AUTOLOAD += "mali dhd"
KERNEL_MODULE_PROBECONF += "dhd"
module_conf_dhd = "options dhd firmware_path=/etc/wifi/4356/ nvram_path=/etc/wifi/4356/nvram.txt"
```

## conf/machine/mesongxl_p230_wayland_drm_32b.conf
```bitbake
#@TYPE: Machine
#@NAME: meson

#@DESCRIPTION: Machine configuration for meson systems

#PREFERRED_PROVIDER_virtual/xserver ?= "xserver-xorg"
#XSERVER ?= "xserver-xorg \
#           xf86-input-evdev \
#           xf86-input-mouse \
#           xf86-video-fbdev \
#           xf86-input-keyboard"

PREFERRED_PROVIDER_virtual/egl = "libgles-drm-32b-wayland"
PREFERRED_PROVIDER_virtual/libgl = "libgles-drm-32b-wayland"
PREFERRED_PROVIDER_virtual/libgles1 = "libgles-drm-32b-wayland"
PREFERRED_PROVIDER_virtual/libgles2 = "libgles-drm-32b-wayland"

MACHINE_ESSENTIAL_EXTRA_RRECOMMENDS += " \
        wififw-bcm4356 \
        "

#MACHINE_EXTRA_RRECOMMENDS = " kernel-modules kernel-devicetree"

#EXTRA_IMAGEDEPENDS += "u-boot"

#include conf/machine/include/tune-cortexa53.inc
require conf/machine/include/tune-cortexa8.inc
require conf/machine/include/amlogic_32b.inc
#DEFAULTTUNE = "cortexa53_32-crypto"

IMAGE_FSTYPES += "tar.gz ext4 cpio.gz"
#IMAGE_FSTYPES += "cpio.gz.u-boot"
#IMAGE_CLASSES += "image_types_uboot"

SERIAL_CONSOLE = "115200 ttyS0"

#PREFERRED_PROVIDER_virtual/kernel ?= "linux-meson"

#KERNEL_IMAGETYPE = "Image.gz"
#KERNEL_DEVICETREE = "gxl_p230_2g.dtb"

#UBOOT_SUFFIX = "bin"
#UBOOT_MACHINE = "gxl_p230_v1_config"

MACHINE_FEATURES = "usbgadget usbhost vfat alsa"

#IMAGE_BOOT_FILES ?= "u-boot.${UBOOT_SUFFIX}"

#INITRAMFS_FILES = "initramfs-default"

KERNEL_MODULE_AUTOLOAD += "mali dhd"
KERNEL_MODULE_PROBECONF += "dhd"
module_conf_dhd = "options dhd firmware_path=/etc/wifi/4356/ nvram_path=/etc/wifi/4356/nvram.txt"
#ROOTFS max in KB
IMAGE_ROOTFS_SIZE_mesongxl_p230_32b = "2097152"
DISTRO_FEATURES_remove += "opengl gl"
DISTRO_FEATURES_remove += "parodus"
VIRTUAL-RUNTIME_alsa-state ?= "alsa-states"
# append drm(wayland drm backend)
DISTRO_FEATURES_append = " drm"
DISTRO_FEATURES_append = " rdkbrowser2"
```
