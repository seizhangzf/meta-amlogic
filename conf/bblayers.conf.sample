## conf/machine/include/amlogic_externalsrc.inc
```bitbake
INHERIT += "externalsrc"

EXTERNALSRC_pn-vmx-sdk-rel = "${@'${RDK_ROOT_PATH}/aml-comp/vendor/vmx/sdk-rel' if (os.path.isdir('${RDK_ROOT_PATH}/aml-comp/vendor/vmx/sdk-rel')) else ''}"
EXTERNALSRC_pn-vmx-release-binaries = "${@'${RDK_ROOT_PATH}/aml-comp/vendor/vmx/vmx_release_binaries' if (os.path.isdir('${RDK_ROOT_PATH}/aml-comp/vendor/vmx/vmx_release_binaries')) else ''}"
EXTERNALSRC_pn-nagra-sdk = "${@'${RDK_ROOT_PATH}/aml-comp/vendor/nagra/nagra-sdk' if (os.path.isdir('${RDK_ROOT_PATH}/aml-comp/vendor/nagra/nagra-sdk')) else ''}"
EXTERNALSRC_pn-wpeframework-ocdm-connect = "${@'${RDK_ROOT_PATH}/aml-comp/thirdparty/OCDM-nagra' if (os.path.isdir('${RDK_ROOT_PATH}/aml-comp/thirdparty/OCDM-nagra')) else ''}"
EXTERNALSRC_pn-nagra-cashal-rel = "${@'${RDK_ROOT_PATH}/aml-comp/vendor/nagra/nagra-cashal-rel' if (os.path.isdir('${RDK_ROOT_PATH}/aml-comp/vendor/nagra/nagra-cashal-rel')) else ''}"
EXTERNALSRC_pn-nagra-cert-prebuilt = "${@'${RDK_ROOT_PATH}/aml-comp/vendor/nagra/nagra-sdk' if (os.path.isdir('${RDK_ROOT_PATH}/aml-comp/vendor/nagra/nagra-sdk')) else ''}"
EXTERNALSRC_pn-irdeto-sdk = "${@'${RDK_ROOT_PATH}/aml-comp/vendor/irdeto/irdeto-sdk' if (os.path.isdir('${RDK_ROOT_PATH}/aml-comp/vendor/irdeto/irdeto-sdk')) else ''}"
EXTERNALSRC_pn-irdeto-hal = "${@'${RDK_ROOT_PATH}/aml-comp/vendor/irdeto/hal' if (os.path.isdir('${RDK_ROOT_PATH}/aml-comp/vendor/irdeto/hal')) else ''}"
EXTERNALSRC_pn-synamedia-sdk = "${@'${RDK_ROOT_PATH}/aml-comp/vendor/synamedia/synamedia-sdk' if (os.path.isdir('${RDK_ROOT_PATH}/aml-comp/vendor/synamedia/synamedia-sdk')) else ''}"

EXTERNALSRC_pn-aml-audio-hal = "${@'${RDK_ROOT_PATH}/aml-comp/multimedia/aml_audio_hal' if (os.path.isdir('${RDK_ROOT_PATH}/aml-comp/multimedia/aml_audio_hal')) else ''}"
EXTERNALSRC_pn-aml-dvbaudioutils = "${@'${RDK_ROOT_PATH}/aml-comp/multimedia/aml_audio_hal' if (os.path.isdir('${RDK_ROOT_PATH}/aml-comp/multimedia/aml_audio_hal')) else ''}"
EXTERNALSRC_pn-aml-audio-service = "${@'${RDK_ROOT_PATH}/aml-comp/multimedia/hal_audio_service' if (os.path.isdir('${RDK_ROOT_PATH}/aml-comp/multimedia/hal_audio_service')) else ''}"
EXTERNALSRC_pn-aml-amaudioutils = "${@'${RDK_ROOT_PATH}/aml-comp/multimedia/aml_amaudioutils' if (os.path.isdir('${RDK_ROOT_PATH}/aml-comp/multimedia/aml_amaudioutils')) else ''}"
EXTERNALSRC_pn-dolby-ms12 = "${@'${RDK_ROOT_PATH}/aml-comp/multimedia/dolby_ms12_release/src' if (os.path.isdir('${RDK_ROOT_PATH}/aml-comp/multimedia/dolby_ms12_release/src')) else ''}"
EXTERNALSRC_pn-optee-video-firmware = "${@'${RDK_ROOT_PATH}/aml-comp/multimedia/secfirmload/secloadbin' if (os.path.isdir('${RDK_ROOT_PATH}/aml-comp/multimedia/secfirmload/secloadbin')) else ''}"
EXTERNALSRC_pn-aml-uvm-test = "${@'${RDK_ROOT_PATH}/aml-comp/multimedia/v4l2-uvm-test' if (os.path.isdir('${RDK_ROOT_PATH}/aml-comp/multimedia/v4l2-uvm-test')) else ''}"
EXTERNALSRC_pn-aml-avsync = "${@'${RDK_ROOT_PATH}/aml-comp/multimedia/avsync-lib' if (os.path.isdir('${RDK_ROOT_PATH}/aml-comp/multimedia/avsync-lib')) else ''}"
EXTERNALSRC_pn-aml-mp-sdk = "${@'${RDK_ROOT_PATH}/aml-comp/multimedia/aml_mp_sdk' if (os.path.isdir('${RDK_ROOT_PATH}/aml-comp/multimedia/aml_mp_sdk')) else ''}"
EXTERNALSRC_pn-android-tools-logcat = "${@'${RDK_ROOT_PATH}/aml-comp/vendor/amlogic/aml_commonlib' if (os.path.isdir('${RDK_ROOT_PATH}/aml-comp/vendor/amlogic/aml_commonlib')) else ''}"
EXTERNALSRC_pn-usb-monitor = "${@'${RDK_ROOT_PATH}/aml-comp/vendor/amlogic/aml_commonlib' if (os.path.isdir('${RDK_ROOT_PATH}/aml-comp/vendor/amlogic/aml_commonlib')) else ''}"
EXTERNALSRC_pn-liblog = "${@'${RDK_ROOT_PATH}/aml-comp/vendor/amlogic/aml_commonlib' if (os.path.isdir('${RDK_ROOT_PATH}/aml-comp/vendor/amlogic/aml_commonlib')) else ''}"
EXTERNALSRC_pn-libatrace = "${@'${RDK_ROOT_PATH}/aml-comp/vendor/amlogic/aml_commonlib' if (os.path.isdir('${RDK_ROOT_PATH}/aml-comp/vendor/amlogic/aml_commonlib')) else ''}"
EXTERNALSRC_pn-qca6174 = "${@'${RDK_ROOT_PATH}/aml-comp/hardware/aml-5.4/wifi/qualcomm/drivers/qca6174' if (os.path.isdir('${RDK_ROOT_PATH}/aml-comp/hardware/aml-5.4/wifi/qualcomm/drivers/qca6174')) else ''}"
EXTERNALSRC_pn-aml-wifi-w1 = "${@'${RDK_ROOT_PATH}/aml-comp/hardware/aml-5.4/wifi/amlogic/drivers/w1' if (os.path.isdir('${RDK_ROOT_PATH}/aml-comp/hardware/aml-5.4/wifi/amlogic/drivers/w1')) else ''}"
EXTERNALSRC_pn-aml-bt-w1 = "${@'${RDK_ROOT_PATH}/aml-comp/hardware/aml-5.4/bluetooth/amlogic' if (os.path.isdir('${RDK_ROOT_PATH}/aml-comp/hardware/aml-5.4/bluetooth/amlogic')) else ''}"
EXTERNALSRC_pn-wififw = "${@'${RDK_ROOT_PATH}/aml-comp/hardware/aml-4.9/amlogic/wifi' if (os.path.isdir('${RDK_ROOT_PATH}/aml-comp/hardware/aml-4.9/amlogic/wifi')) else ''}"

EXTERNALSRC_pn-rtk8723bu = "${@'${RDK_ROOT_PATH}/aml-comp/hardware/aml-5.4/wifi/realtek/drivers/8723bu' if (os.path.isdir('${RDK_ROOT_PATH}/aml-comp/hardware/aml-5.4/wifi/realtek/drivers/8723bu')) else ''}"
EXTERNALSRC_pn-rtk8723du = "${@'${RDK_ROOT_PATH}/aml-comp/hardware/aml-5.4/wifi/realtek/drivers/8723du' if (os.path.isdir('${RDK_ROOT_PATH}/aml-comp/hardware/aml-5.4/wifi/realtek/drivers/8723du')) else ''}"
EXTERNALSRC_pn-rtk8822cs = "${@'${RDK_ROOT_PATH}/aml-comp/hardware/aml-5.4/wifi/realtek/drivers/8822cs' if (os.path.isdir('${RDK_ROOT_PATH}/aml-comp/hardware/aml-5.4/wifi/realtek/drivers/8822cs')) else ''}"
EXTERNALSRC_pn-realtek-btusb = "${@'${RDK_ROOT_PATH}/aml-comp/hardware/aml-5.4/bluetooth/realtek' if (os.path.isdir('${RDK_ROOT_PATH}/aml-comp/hardware/aml-5.4/bluetooth/realtek')) else''}"
EXTERNALSRC_pn-realtek-btuart = "${@'${RDK_ROOT_PATH}/aml-comp/hardware/aml-5.4/bluetooth/realtek' if (os.path.isdir('${RDK_ROOT_PATH}/aml-comp/hardware/aml-5.4/bluetooth/realtek')) else''}"
EXTERNALSRC_pn-realtek-hciattach = "${@'${RDK_ROOT_PATH}/aml-comp/hardware/aml-5.4/bluetooth/realtek' if (os.path.isdir('${RDK_ROOT_PATH}/aml-comp/hardware/aml-5.4/bluetooth/realtek')) else''}"

EXTERNALSRC_pn-aml-hdcp = "${@'${RDK_ROOT_PATH}/aml-comp/vendor/amlogic/hdcp' if (os.path.isdir('${RDK_ROOT_PATH}/aml-comp/vendor/amlogic/hdcp')) else ''}"
EXTERNALSRC_pn-aml-provision = "${@'${RDK_ROOT_PATH}/aml-comp/vendor/amlogic/provision' if (os.path.isdir('${RDK_ROOT_PATH}/aml-comp/vendor/amlogic/provision')) else ''}"
EXTERNALSRC_pn-aml-sesg = "${@'${RDK_ROOT_PATH}/aml-comp/vendor/amlogic/sesg' if (os.path.isdir('${RDK_ROOT_PATH}/aml-comp/vendor/amlogic/sesg')) else ''}"

#tdk-3.8 is default
EXTERNALSRC_pn-optee-userspace = "${@'${RDK_ROOT_PATH}/aml-comp/vendor/amlogic/tdk-3.8' if (os.path.isdir('${RDK_ROOT_PATH}/aml-comp/vendor/amlogic/tdk-3.8')) else ''}"
EXTERNALSRC_pn-optee-scripts-native = "${@'${RDK_ROOT_PATH}/aml-comp/vendor/amlogic/tdk-3.8' if (os.path.isdir('${RDK_ROOT_PATH}/aml-comp/vendor/amlogic/tdk-3.8')) else ''}"
EXTERNALSRC_pn-optee-linux-driver = "${@'${RDK_ROOT_PATH}/aml-comp/vendor/amlogic/tdk-3.8' if (os.path.isdir('${RDK_ROOT_PATH}/aml-comp/vendor/amlogic/tdk-3.8')) else ''}"
#tdk-2.4 need set OVERRIDES
EXTERNALSRC_pn-optee-userspace_tdk-2.4 = "${@'${RDK_ROOT_PATH}/aml-comp/vendor/amlogic/tdk' if (os.path.isdir('${RDK_ROOT_PATH}/aml-comp/vendor/amlogic/tdk')) else ''}"
EXTERNALSRC_pn-optee-scripts-native_tdk-2.4 = "${@'${RDK_ROOT_PATH}/aml-comp/vendor/amlogic/tdk' if (os.path.isdir('${RDK_ROOT_PATH}/aml-comp/vendor/amlogic/tdk')) else ''}"
EXTERNALSRC_pn-optee-linux-driver_tdk-2.4 = "${@'${RDK_ROOT_PATH}/aml-comp/vendor/amlogic/tdk' if (os.path.isdir('${RDK_ROOT_PATH}/aml-comp/vendor/amlogic/tdk')) else ''}"


EXTERNALSRC_pn-aml-mediadrm-widevine = "${@'${RDK_ROOT_PATH}/aml-comp/multimedia/libmediadrm' if (os.path.isdir('${RDK_ROOT_PATH}/aml-comp/multimedia/libmediadrm')) else ''}"
EXTERNALSRC_pn-aml-netflix-esn = "${@'${RDK_ROOT_PATH}/aml-comp/multimedia/libmediadrm' if (os.path.isdir('${RDK_ROOT_PATH}/aml-comp/multimedia/libmediadrm')) else ''}"
EXTERNALSRC_pn-aml-mediahal-sdk = "${@'${RDK_ROOT_PATH}/aml-comp/multimedia/mediahal-sdk' if (os.path.isdir('${RDK_ROOT_PATH}/aml-comp/multimedia/mediahal-sdk')) else ''}"
EXTERNALSRC_pn-aml-secmem = "${@'${RDK_ROOT_PATH}/aml-comp/multimedia/libmediadrm' if (os.path.isdir('${RDK_ROOT_PATH}/aml-comp/multimedia/libmediadrm')) else ''}"
EXTERNALSRC_pn-aml-youtubesign-bin = "${@'${RDK_ROOT_PATH}/aml-comp/multimedia/libmediadrm/' if (os.path.isdir('${RDK_ROOT_PATH}/aml-comp/multimedia/libmediadrm/')) else ''}"
EXTERNALSRC_pn-aml-mediadrm-cleartvp-bin = "${@'${RDK_ROOT_PATH}/aml-comp/multimedia/libmediadrm/' if (os.path.isdir('${RDK_ROOT_PATH}/aml-comp/multimedia/libmediadrm/')) else ''}"
EXTERNALSRC_pn-playready = "${@'${RDK_ROOT_PATH}/aml-comp/multimedia/libmediadrm/playready-bin' if (os.path.isdir('${RDK_ROOT_PATH}/aml-comp/multimedia/libmediadrm/playready-bin')) else ''}"
EXTERNALSRC_pn-gst-plugin-aml-asink = "${@'${RDK_ROOT_PATH}/aml-comp/multimedia/gst-plugin-aml-asink' if (os.path.isdir('${RDK_ROOT_PATH}/aml-comp/multimedia/gst-plugin-aml-asink')) else ''}"
EXTERNALSRC_pn-gst-plugin-pcr-sink = "${@'${RDK_ROOT_PATH}/aml-comp/multimedia/gst-plugin-pcr-sink' if (os.path.isdir('${RDK_ROOT_PATH}/aml-comp/multimedia/gst-plugin-pcr-sink')) else ''}"
EXTERNALSRC_pn-gstqamtunersrc-aml = "${@'${RDK_ROOT_PATH}/aml-comp/rdk/qamtunersrc-aml' if (os.path.isdir('${RDK_ROOT_PATH}/aml-comp/rdk/qamtunersrc-aml')) else ''}"
EXTERNALSRC_pn-gst-aml-drm-plugins = "${@'${RDK_ROOT_PATH}/aml-comp/multimedia/gst-aml-drm-plugins1/gst-aml-drm-plugins-1.0' if (os.path.isdir('${RDK_ROOT_PATH}/aml-comp/multimedia/gst-aml-drm-plugins1/gst-aml-drm-plugins-1.0')) else ''}"
EXTERNALSRC_pn-dvalin = "${@'${RDK_ROOT_PATH}/aml-comp/hardware/aml-4.9/arm/gpu' if (os.path.isdir('${RDK_ROOT_PATH}/aml-comp/hardware/aml-4.9/arm/gpu')) else ''}"
EXTERNALSRC_pn-libgles-eabihf-dvalin-wayland-drm = "${@'${RDK_ROOT_PATH}/aml-comp/vendor/amlogic/meson_mali' if (os.path.isdir('${RDK_ROOT_PATH}/aml-comp/vendor/amlogic/meson_mali')) else ''}"

EXTERNALSRC_pn-u-boot = "${@'${RDK_ROOT_PATH}/aml-comp/uboot' if (os.path.isdir('${RDK_ROOT_PATH}/aml-comp/uboot')) else ''}"

EXTERNALSRC_pn-linux-meson = "${@'${RDK_ROOT_PATH}/aml-comp/kernel/aml-5.4' if (os.path.isdir('${RDK_ROOT_PATH}/aml-comp/kernel/aml-5.4')) else ''}"

EXTERNALSRC_pn-media-modules = "${@'${RDK_ROOT_PATH}/aml-comp/hardware/aml-5.4/amlogic/media_modules' if (os.path.isdir('${RDK_ROOT_PATH}/aml-comp/hardware/aml-5.4/amlogic/media_modules')) else ''}"

EXTERNALSRC_pn-aucpu-fw = "${@'${RDK_ROOT_PATH}/aml-comp/vendor/amlogic/aucpu_fw' if (os.path.isdir('${RDK_ROOT_PATH}/aml-comp/vendor/amlogic/aucpu_fw')) else ''}"
EXTERNALSRC_pn-aml-tvserver = "${@'${RDK_ROOT_PATH}/aml-comp/vendor/amlogic/aml_tvserver' if (os.path.isdir('${RDK_ROOT_PATH}/aml-comp/vendor/amlogic/aml_tvserver')) else ''}"
EXTERNALSRC_pn-aml-pqserver = "${@'${RDK_ROOT_PATH}/aml-comp/vendor/amlogic/aml_pqserver' if (os.path.isdir('${RDK_ROOT_PATH}/aml-comp/vendor/amlogic/aml_pqserver')) else ''}"
EXTERNALSRC_pn-aml-dvb = "${@'${RDK_ROOT_PATH}/aml-comp/vendor/amlogic/dvb' if (os.path.isdir('${RDK_ROOT_PATH}/aml-comp/vendor/amlogic/dvb')) else ''}"
EXTERNALSRC_pn-aml-zvbi = "${@'${RDK_ROOT_PATH}/aml-comp/vendor/amlogic/zvbi' if (os.path.isdir('${RDK_ROOT_PATH}/aml-comp/vendor/amlogic/zvbi')) else ''}"
EXTERNALSRC_pn-libamavutils = "${@'${RDK_ROOT_PATH}/aml-comp/multimedia/libplayer/src' if (os.path.isdir('${RDK_ROOT_PATH}/aml-comp/multimedia/libplayer/src')) else ''}"
EXTERNALSRC_pn-libamadec = "${@'${RDK_ROOT_PATH}/aml-comp/multimedia/libplayer/src' if (os.path.isdir('${RDK_ROOT_PATH}/aml-comp/multimedia/libplayer/src')) else ''}"
#EXTERNALSRC_pn-libdvr-release = "${@'${RDK_ROOT_PATH}/aml-comp/multimedia/libdvr_release' if (os.path.isdir('${RDK_ROOT_PATH}/aml-comp/multimedia/libdvr_release')) else ''}"
EXTERNALSRC_pn-aml-libdvr = "${@'${RDK_ROOT_PATH}/aml-comp/multimedia/libdvr' if (os.path.isdir('${RDK_ROOT_PATH}/aml-comp/multimedia/libdvr')) else ''}"
EXTERNALSRC_pn-aml-cas-hal = "${@'${RDK_ROOT_PATH}/aml-comp/multimedia/cas-hal' if (os.path.isdir('${RDK_ROOT_PATH}/aml-comp/multimedia/cas-hal')) else ''}"
EXTERNALSRC_pn-aml-secdmx = "${@'${RDK_ROOT_PATH}/aml-comp/vendor/amlogic/libsecdmx_release' if (os.path.isdir('${RDK_ROOT_PATH}/aml-comp/vendor/amlogic/libsecdmx_release')) else ''}"
EXTERNALSRC_pn-vendor-files = "${@'${RDK_ROOT_PATH}/aml-comp/prebuilt/vendor' if (os.path.isdir('${RDK_ROOT_PATH}/aml-comp/prebuilt/vendor')) else ''}"
EXTERNALSRC_pn-tuner-prebuilt = "${@'${RDK_ROOT_PATH}/aml-comp/prebuilt/target' if (os.path.isdir('${RDK_ROOT_PATH}/aml-comp/prebuilt/target')) else ''}"
EXTERNALSRC_pn-pq-prebuilt = "${@'${RDK_ROOT_PATH}/aml-comp/prebuilt/target' if (os.path.isdir('${RDK_ROOT_PATH}/aml-comp/prebuilt/target')) else ''}"
EXTERNALSRC_pn-dtvkit-release-prebuilt = "${@'${RDK_ROOT_PATH}/aml-comp/prebuilt/dtvkit-release' if (os.path.isdir('${RDK_ROOT_PATH}/aml-comp/prebuilt/dtvkit-release')) else ''}"
EXTERNALSRC_pn-aml-img-packer-native = "${@'${RDK_ROOT_PATH}/aml-comp/prebuilt/hosttools' if (os.path.isdir('${RDK_ROOT_PATH}/aml-comp/prebuilt/hosttools')) else ''}"
EXTERNALSRC_pn-aml-hosttools-native = "${@'${RDK_ROOT_PATH}/aml-comp/prebuilt/hosttools' if (os.path.isdir('${RDK_ROOT_PATH}/aml-comp/prebuilt/hosttools')) else ''}"
EXTERNALSRC_pn-devicesettings-hal-amlogic = "${@'${RDK_ROOT_PATH}/aml-comp/rdk/Devicesettings-hal' if (os.path.isdir('${RDK_ROOT_PATH}/aml-comp/rdk/Devicesettings-hal')) else ''}"
EXTERNALSRC_pn-iarmmgrs-hal-amlogic = "${@'${RDK_ROOT_PATH}/aml-comp/rdk/Iarmmgrs-hal' if (os.path.isdir('${RDK_ROOT_PATH}/aml-comp/rdk/Iarmmgrs-hal')) else ''}"
EXTERNALSRC_pn-mfrbootenvtools-amlogic = "${@'${RDK_ROOT_PATH}/aml-comp/rdk/mfrbootenvtools' if (os.path.isdir('${RDK_ROOT_PATH}/aml-comp/rdk/mfrbootenvtools')) else ''}"
EXTERNALSRC_pn-mfrlib-amlogic = "${@'${RDK_ROOT_PATH}/aml-comp/rdk/Mfrlib' if (os.path.isdir('${RDK_ROOT_PATH}/aml-comp/rdk/Mfrlib')) else ''}"
EXTERNALSRC_pn-aml-rdkcryptoapi = "${@'${RDK_ROOT_PATH}/aml-comp/vendor/amlogic/secapi_ca' if (os.path.isdir('${RDK_ROOT_PATH}/aml-comp/vendor/amlogic/secapi_ca')) else ''}"
EXTERNALSRC_pn-libbinder = "${@'${RDK_ROOT_PATH}/aml-comp/vendor/amlogic/aml_commonlib/libbinder' if (os.path.isdir('${RDK_ROOT_PATH}/aml-comp/vendor/amlogic/aml_commonlib/libbinder')) else ''}"
EXTERNALSRC_pn-wifi-amlogic = "${@'${RDK_ROOT_PATH}/aml-comp/vendor/amlogic/aml_commonlib' if (os.path.isdir('${RDK_ROOT_PATH}/aml-comp/vendor/amlogic/aml_commonlib')) else ''}"
EXTERNALSRC_pn-netflix-aml = "${@'${RDK_ROOT_PATH}/aml-comp/thirdparty/netflix' if (os.path.isdir('${RDK_ROOT_PATH}/aml-comp/thirdparty/netflix')) else ''}"
EXTERNALSRC_pn-netflix-prebuilt-dep = "${@'${RDK_ROOT_PATH}/aml-comp/thirdparty/netflix' if (os.path.isdir('${RDK_ROOT_PATH}/aml-comp/thirdparty/netflix')) else ''}"
EXTERNALSRC_pn-wpeframework-plugin-netflix = "${@'${RDK_ROOT_PATH}/aml-comp/thirdparty/wpe-plugin-netflix' if (os.path.isdir('${RDK_ROOT_PATH}/aml-comp/thirdparty/wpe-plugin-netflix')) else ''}"
EXTERNALSRC_pn-wpeframework-ocdm-playready = "${@'${RDK_ROOT_PATH}/aml-comp/rdk/OCDM-playready' if (os.path.isdir('${RDK_ROOT_PATH}/aml-comp/rdk/OCDM-playready')) else ''}"
EXTERNALSRC_pn-wpeframework-ocdm-widevine = "${@'${RDK_ROOT_PATH}/aml-comp/rdk/OCDM-widevine' if (os.path.isdir('${RDK_ROOT_PATH}/aml-comp/rdk/OCDM-widevine')) else ''}"
EXTERNALSRC_pn-aml-cobalt-starboard = "${@'${RDK_ROOT_PATH}/aml-comp/vendor/amlogic/cobalt/rdkcobalt-21' if (os.path.isdir('${RDK_ROOT_PATH}/aml-comp/vendor/amlogic/cobalt/rdkcobalt-21')) else ''}"
EXTERNALSRC_pn-wifi-amlogic = "${@'${RDK_ROOT_PATH}/aml-comp/vendor/amlogic/aml_commonlib' if (os.path.isdir('${RDK_ROOT_PATH}/aml-comp/vendor/amlogic/aml_commonlib')) else ''}"
EXTERNALSRC_pn-gst-plugins-playersinkbin-aml = "${@'${RDK_ROOT_PATH}/aml-comp/rdk/playersinkbin-aml' if (os.path.isdir('${RDK_ROOT_PATH}/aml-comp/rdk/playersinkbin-aml')) else ''}"
EXTERNALSRC_pn-aml-residentapp = "${@'${RDK_ROOT_PATH}/aml-comp/rdk/residentapp' if (os.path.isdir('${RDK_ROOT_PATH}/aml-comp/rdk/residentapp')) else ''}"
EXTERNALSRC_pn-drmplayer-bin = "${@'${RDK_ROOT_PATH}/aml-comp/multimedia/libmediadrm/drmplayer-bin/prebuilt' if (os.path.isdir('${RDK_ROOT_PATH}/aml-comp/multimedia/libmediadrm/drmplayer-bin/prebuilt')) else ''}"
EXTERNALSRC_pn-sectionfilter-hal-amlogic = "${@'${RDK_ROOT_PATH}/aml-comp/rdk/mediaframework/soc_qamsource' if (os.path.isdir('${RDK_ROOT_PATH}/aml-comp/rdk/mediaframework/soc_qamsource')) else ''}"
EXTERNALSRC_pn-dvrmgr-hal-amlogic = "${@'${RDK_ROOT_PATH}/aml-comp/rdk/mediaframework/dvr/common/dvrmgr/soc' if (os.path.isdir('${RDK_ROOT_PATH}/aml-comp/rdk/mediaframework/dvr/common/dvrmgr/soc')) else ''}"
EXTERNALSRC_pn-rmfhalheaders = "${@'${RDK_ROOT_PATH}/aml-comp/rdk/mediaframework/' if (os.path.isdir('${RDK_ROOT_PATH}/aml-comp/rdk/mediaframework/')) else ''}"
EXTERNALSRC_pn-iptv-eos = "${@'${RDK_ROOT_PATH}/aml-comp/thirdparty/iptv-eos' if (os.path.isdir('${RDK_ROOT_PATH}/aml-comp/thirdparty/iptv-eos')) else ''}"
EXTERNALSRC_pn-wpeframework-plugin-iptv = "${@'${RDK_ROOT_PATH}/aml-comp/rdk/iptv-rdkservice' if (os.path.isdir('${RDK_ROOT_PATH}/aml-comp/rdk/iptv-rdkservice')) else ''}"
```
